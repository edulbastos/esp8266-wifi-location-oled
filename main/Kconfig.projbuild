## main/Kconfig.projbuild
```kconfig
menu "WiFi Location Configuration"

    config WIFI_SSID
        string "WiFi SSID"
        default "YOUR_WIFI_SSID"
        help
            SSID (network name) for the ESP to connect to.

    config WIFI_PASSWORD
        string "WiFi Password"
        default "YOUR_WIFI_PASSWORD"
        help
            WiFi password (WPA or WPA2) for the ESP to use.

    config GOOGLE_API_KEY
        string "Google Geolocation API Key"
        default "YOUR_GOOGLE_API_KEY"
        help
            API key for Google Geolocation API.
            Get your key at: https://developers.google.com/maps/documentation/geolocation/get-api-key

    config LOCATION_UPDATE_INTERVAL
        int "Location Update Interval (seconds)"
        default 300
        range 30 3600
        help
            Time interval between location updates in seconds.
            Minimum: 30 seconds
            Maximum: 3600 seconds (1 hour)

endmenu
```

## sdkconfig.defaults.example
```kconfig
# Enable WiFi
CONFIG_ESP8266_WIFI_ENABLED=y

# Increase main task stack size
CONFIG_MAIN_TASK_STACK_SIZE=4096

# Enable HTTPS
CONFIG_MBEDTLS_SSL_PROTO_TLS1_2=y
CONFIG_MBEDTLS_CERTIFICATE_BUNDLE=y

# WiFi Configuration
CONFIG_ESP8266_WIFI_STATIC_RX_BUFFER_NUM=10
CONFIG_ESP8266_WIFI_DYNAMIC_RX_BUFFER_NUM=32
CONFIG_ESP8266_WIFI_DYNAMIC_TX_BUFFER_NUM=32

# WiFi Location Custom Configuration
# IMPORTANTE: Copie este arquivo para sdkconfig.defaults e preencha com suas credenciais
CONFIG_WIFI_SSID="SEU_SSID_AQUI"
CONFIG_WIFI_PASSWORD="SUA_SENHA_AQUI"
CONFIG_GOOGLE_API_KEY="SUA_CHAVE_GOOGLE_API_AQUI"
CONFIG_LOCATION_UPDATE_INTERVAL=300
```
